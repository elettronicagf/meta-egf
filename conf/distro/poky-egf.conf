## conf/distro/poky-egf.conf
```bitbake
require conf/distro/poky.conf

DISTRO = "poky-egf"
#GF_BOARD CONDIZIONA IL PATH DI INSTALLAZIONE DELL"SDK
GF_BOARD = "0424"

#GF_YOCTO_SDK_VERSION E' PARTE DEL NOME DEL SDK GENERATO E CONDIZIONA
#IL PATH DI INSTALLAZIONE
GF_YOCTO_SDK_VERSION = "3.0"

#GF_YOCTO_ROOTFS_VERSION VERSIONE DELL'IMMAGINE DI PRODUZIONE
GF_YOCTO_ROOTFS_VERSION = "3.1"

#GF_YOCTO_ROOTFS_LIVE_VERSION VERSIONE DELL'IMMAGINE LIVE 
#PER AGGIORNAMENTO
GF_YOCTO_ROOTFS_LIVE_VERSION = "4.2"

#DISTRO_VERSION INDICA SOLO IL TIPO DI IMMAGINE NON LA VERSIONE
DISTRO_VERSION = "poky-ceflagui"
DISTRO_NAME = "(Yocto Project 1.3) "

MAINTAINER = "ElettronicaGF <arm.embedded@elettronicagf.it>"


#impostare correttamente il valore del parametro --strip-components=6 nel file meta/classes/populate_sdk_base.bbclass
SDKPATH = "/opt/${GF_BOARD}/sdk/toolchain/${GF_YOCTO_SDK_VERSION}"
DISTRO_FEATURES = "alsa argp ext2 largefile  usbgadget usbhost xattr ${DISTRO_FEATURES_LIBC} x11 opengl "
```

## conf/distro/pokyegf.conf
```bitbake
include conf/distro/include/fsl-imx-base.inc
include conf/distro/include/fsl-imx-preferred-env.inc

DISTRO = "pokyegf"
DISTRO_NAME = "Poky egf"
DISTRO_VERSION = "egf"
SDK_VENDOR = "-egf"
SDK_VERSION := "${@'${DISTRO_VERSION}'.replace('snapshot-${DATE}','snapshot')}"

TARGET_VENDOR = "-egf"

#POKY_DEFAULT_DISTRO_FEATURES = "largefile opengl ptest multiarch x11"
#DISTRO_FEATURES ?= "${DISTRO_FEATURES_DEFAULT} ${DISTRO_FEATURES_LIBC} ${POKY_DEFAULT_DISTRO_FEATURES}"

# Remove conflicting backends.
DISTRO_FEATURES_remove = "wayland"
DISTRO_FEATURES_remove = "nfc"
#DISTRO_FEATURES_remove = "ptest"
#QEMU_TARGETS = ""

# These are X11 specific
DISTRO_FEATURES_append = " x11"

#GF_BOARD CONDIZIONA IL PATH DI INSTALLAZIONE DELL"SDK
GF_BOARD = "0533_panel_pc"

#GF_YOCTO_SDK_VERSION E' PARTE DEL NOME DEL SDK GENERATO E CONDIZIONA
#IL PATH DI INSTALLAZIONE
GF_YOCTO_SDK_VERSION = "1.0"

#GF_YOCTO_ROOTFS_VERSION VERSIONE DELL'IMMAGINE DI PRODUZIONE
GF_YOCTO_ROOTFS_VERSION = "1.0"

#GF_YOCTO_ROOTFS_LIVE_VERSION VERSIONE DELL'IMMAGINE LIVE 
#PER AGGIORNAMENTO
GF_YOCTO_ROOTFS_LIVE_VERSION = "1.0"

#DISTRO_VERSION INDICA SOLO IL TIPO DI IMMAGINE NON LA VERSIONE
MAINTAINER = "ElettronicaGF <arm.embedded@elettronicagf.it>"
SDKPATH = "/opt/${GF_BOARD}/sdk/toolchain/${GF_YOCTO_SDK_VERSION}"

IMAGE_FSTYPES = "tar.bz2"
```

## conf/layer.conf
```bitbake
# We have a conf and classes directory, add to BBPATH
BBPATH := "${BBPATH}:${LAYERDIR}"

# We have a packages directory, add to BBFILES
BBFILES := "${BBFILES} ${LAYERDIR}/recipes-*/*/*.bb \
            ${LAYERDIR}/recipes-*/*/*.bbappend"

BBFILE_COLLECTIONS += "egf"
BBFILE_PATTERN_egf := "^${LAYERDIR}/"
BBFILE_PRIORITY_egf = "5"



#needed to accept the Freescale EULA
ACCEPT_FSL_EULA = "1"
```

## conf/machine/0510smggrf.conf
```bitbake
#@TYPE: Machine
#@NAME: i.MX6 SMGGRF boards
#@SOC: i.MX6 
#@DESCRIPTION: Machine configuration for SMGGRF
#@MAINTAINER: Elettronica GF

require conf/machine/include/imx-base.inc
require conf/machine/include/tune-cortexa9.inc

SOC_FAMILY = "mx6:mx6dl"

KERNEL_DEVICETREE = ""

MACHINE_FEATURES += " wifi bluetooth"

MACHINE_EXTRA_RRECOMMENDS_remove = "kernel-modules"
MACHINE_FIRMWARE_remove_mx6 = "firmware-imx-epdc"

KERNEL_IMAGETYPE = "zImage"
SERIAL_CONSOLES = "115200;ttymxc0"
```

## conf/machine/0511socioimx6qdl.conf
```bitbake
#@TYPE: Machine
#@NAME: Freescale i.MX6Q SABRE Smart Device
#@SOC: i.MX6Q
#@DESCRIPTION: Machine configuration for Freescale i.MX6Q SABRE Smart Device
#@MAINTAINER: Otavio Salvador <otavio@ossystems.com.br>

require conf/machine/include/imx6sabresd-common.inc

SOC_FAMILY = "mx6:mx6dl:mx6q"

KERNEL_DEVICETREE = ""

UBOOT_CONFIG ??= "sd"
UBOOT_CONFIG[sd] = "mx6qsabresd_config,sdcard"
UBOOT_CONFIG[sata] = "mx6qsabresd_sata_config"
UBOOT_CONFIG[mfgtool] = "mx6qsabresd_config"

MACHINE_EXTRA_RRECOMMENDS_remove_mx6 = "kernel-modules"

IMAGE_FSTYPES = "ubi tar.bz2"
UBI_VOLNAME = "rootfs"
MKUBIFS_ARGS = "-m 2048 -e 126976 -c 3836"
UBINIZE_ARGS = "-m 2048 -p 128KiB -s 2048"
```

## conf/machine/0533panelpcimx6dl.conf
```bitbake
#@TYPE: Machine
#@NAME: ElettronicaGF 0533 PanelPC (i.MX6DL)
#@SOC: i.MX6DL
#@DESCRIPTION: Machine configuration for 0533 PanelPC (i.MX6DL)
#@MAINTAINER: Elettronica GF

require conf/machine/include/imx6sabresd-common.inc

SOC_FAMILY = "mx6:mx6dl"

KERNEL_DEVICETREE = "imx6-egf-WID0510_AA01.01.dtb \
					 imx6-egf-WID0510_AB01.01.dtb \
					 imx6-egf-WID0510_AC01.01.dtb \
					 imx6-egf-WID0510_AD01.01.dtb \
					 imx6-egf-WID0510_AE01.01.dtb \
					 imx6-egf-WID0510_AF01.01.dtb \
					 "
					 
UBOOT_CONFIG ??= "sd"
UBOOT_CONFIG[sd] = "mx6dlsabresd_config,sdcard"
UBOOT_CONFIG[epdc] = "mx6dlsabresd_epdc_config"
UBOOT_CONFIG[mfgtool] = "mx6dlsabresd_config"

#MACHINE_EXTRA_RRECOMMENDS_remove_mx6 = "kernel-modules"

MACHINE_FEATURES_remove = "pci"

KERNEL_IMAGETYPE = "zImage"
IMAGE_FSTYPES = "tar.bz2 sdcard"
```

## conf/machine/0533panelpcimx6q.conf
```bitbake
#@TYPE: Machine
#@NAME: ElettronicaGF 0533 PanelPC (i.MX6Q)
#@SOC: i.MX6Q
#@DESCRIPTION: Machine configuration for 0533 PanelPC (i.MX6Q)
#@MAINTAINER: Elettronica GF

require conf/machine/include/imx6sabresd-common.inc

SOC_FAMILY = "mx6:mx6q"

KERNEL_DEVICETREE = "imx6-egf-WID0510_AA01.01.dtb \
					 imx6-egf-WID0510_AB01.01.dtb \
					 imx6-egf-WID0510_AC01.01.dtb \
					 imx6-egf-WID0510_AD01.01.dtb \
					 imx6-egf-WID0510_AE01.01.dtb \
					 "

UBOOT_CONFIG ??= "sd"
UBOOT_CONFIG[sd] = "mx6qsabresd_config,sdcard"
UBOOT_CONFIG[sata] = "mx6qsabresd_sata_config"
UBOOT_CONFIG[mfgtool] = "mx6qsabresd_config"

#MACHINE_EXTRA_RRECOMMENDS_remove_mx6 = "kernel-modules"

MACHINE_FEATURES_remove = "pci"

KERNEL_IMAGETYPE = "zImage"
IMAGE_FSTYPES = "tar.bz2 sdcard"
```

## conf/machine/0533panelpcimx6qdlsolo.conf
```bitbake
#@TYPE: Machine
#@NAME: ElettronicaGF 0533 PanelPC (i.MX6Q/DL/Solo)
#@SOC: i.MX6 Quad Dual and Solo
#@DESCRIPTION: Machine configuration for 0533 PanelPC (i.MX6Q/DL/Solo)
#@MAINTAINER: Elettronica GF

require conf/machine/include/imx6sabresd-common.inc

SOC_FAMILY = "mx6:mx6q"

KERNEL_DEVICETREE = "imx6-egf-WID0510_AA01.01.dtb \
					 imx6-egf-WID0510_AB01.01.dtb \
					 imx6-egf-WID0510_AC01.01.dtb \
					 imx6-egf-WID0510_AD01.01.dtb \
					 imx6-egf-WID0510_AE01.01.dtb \
					 imx6-egf-WID0510_AF01.01.dtb \
					 imx6-egf-WID0510_AG01.01.dtb \
					 "

UBOOT_CONFIG ??= "sd"
UBOOT_CONFIG[sd] = "mx6dlsabresd_config,sdcard"
UBOOT_CONFIG[epdc] = "mx6dlsabresd_epdc_config"
UBOOT_CONFIG[mfgtool] = "mx6dlsabresd_config"

#MACHINE_EXTRA_RRECOMMENDS_remove_mx6 = "kernel-modules"

# build all vpu firmware packages into the image
MACHINE_FIRMWARE_append_mx6 = " firmware-imx-vpu-imx6q firmware-imx-vpu-imx6d firmware-imx-epdc"

MACHINE_FEATURES_remove = "pci"

KERNEL_IMAGETYPE = "zImage"
IMAGE_FSTYPES = "tar.bz2 sdcard"
```

## conf/machine/0541evbimx6qdl.conf
```bitbake
#@TYPE: Machine
#@NAME: ElettronicaGF i.MX6Q som 0500 evaluation board
#@SOC: i.MX6Q
#@DESCRIPTION: Machine configuration for Freescale i.MX6Q SABRE Smart Device


require conf/machine/include/imx6sabresd-common.inc

SOC_FAMILY = "mx6:mx6dl:mx6q"

KERNEL_DEVICETREE = ""

UBOOT_CONFIG ??= "sd"
UBOOT_CONFIG[sd] = "mx6qsabresd_config,sdcard"
UBOOT_CONFIG[sata] = "mx6qsabresd_sata_config"
UBOOT_CONFIG[mfgtool] = "mx6qsabresd_config"

MACHINE_EXTRA_RRECOMMENDS_remove_mx6 = "kernel-modules"

IMAGE_FSTYPES = "tar.bz2"
UBI_VOLNAME = "rootfs"
MKUBIFS_ARGS = "-m 2048 -e 126976 -c 3836"
UBINIZE_ARGS = "-m 2048 -p 128KiB -s 2048"
```

## conf/machine/0541evbpopimx6q.conf
```bitbake
#@TYPE: Machine
#@NAME: ElettronicaGF 0541 EVB PoP (i.MX6D/Q)
#@SOC: i.MX6D/Q
#@DESCRIPTION: Machine configuration for 0533 PanelPC (i.MX6D/Q)
#@MAINTAINER: Elettronica GF

require conf/machine/include/imx6sabresd-common.inc

SOC_FAMILY = "mx6:mx6q"

KERNEL_DEVICETREE = "imx6-egf-WID0500_AA01.01.dtb \
					 imx6-egf-WID0500_AB01.01.dtb \
					"

UBOOT_CONFIG ??= "sd"
UBOOT_CONFIG[sd] = "mx6qsabresd_config,sdcard"
UBOOT_CONFIG[sata] = "mx6qsabresd_sata_config"
UBOOT_CONFIG[mfgtool] = "mx6qsabresd_config"

MACHINE_FEATURES_remove = "pci"

KERNEL_IMAGETYPE = "zImage"
IMAGE_FSTYPES = "tar.bz2 sdcard"
```

## conf/machine/0571consolesmart.conf
```bitbake
#@TYPE: Machine
#@NAME: Cefla 0571 console smart
#@SOC: i.MX6 UL
#@DESCRIPTION: Machine configuration for 0571 
#@MAINTAINER: Elettronica GF

include conf/machine/include/imx-base.inc
include conf/machine/include/tune-cortexa7.inc
include conf/machine/include/imx6ul-common.inc

SOC_FAMILY = "mx6ul"

KERNEL_DEVICETREE = "imx6ul-14x14-ddr3-arm2.dtb \
					 "

UBOOT_CONFIG ??= "sd"
UBOOT_CONFIG[sd] = "mx6ul_14x14_evk_config,sdcard"
UBOOT_CONFIG[emmc] = "mx6ul_14x14_evk_emmc_config,sdcard"
UBOOT_CONFIG[mfgtool] = "mx6ul_14x14_evk_config"

KERNEL_IMAGETYPE = "zImage"
IMAGE_FSTYPES = "tar.bz2"

SERIAL_CONSOLES = "ttymxc4"
```

## conf/machine/0572consolefulltouch.conf
```bitbake
#@TYPE: Machine
#@NAME: Cefla 0572 console full touch
#@SOC: i.MX6 
#@DESCRIPTION: Machine configuration for 0572
#@MAINTAINER: Elettronica GF

require conf/machine/include/imx6sabresd-common.inc

SOC_FAMILY = "mx6:mx6dl"

KERNEL_DEVICETREE = "imx6-egf-WID0510_AH01.01.dtb \
					 imx6-egf-WID0510_AI01.01.dtb \
					 "

UBOOT_CONFIG ??= "sd"
UBOOT_CONFIG[sd] = "mx6dlsabresd_config,sdcard"
UBOOT_CONFIG[epdc] = "mx6dlsabresd_epdc_config"
UBOOT_CONFIG[mfgtool] = "mx6dlsabresd_config"

#MACHINE_EXTRA_RRECOMMENDS_remove_mx6 = "kernel-modules"

# build all vpu firmware packages into the image
#MACHINE_FIRMWARE_append_mx6 = " firmware-imx-vpu-imx6q firmware-imx-vpu-imx6d firmware-imx-epdc"

MACHINE_FEATURES_remove = "pci"

KERNEL_IMAGETYPE = "zImage"
SERIAL_CONSOLES = "115200;ttymxc4"
```

## conf/machine/0574evbimx7.conf
```bitbake
#@TYPE: Machine
#@NAME: ElettronicaGF 0574 evaluation board for 0575 imx7 som
#@SOC: i.MX7
#@DESCRIPTION: Machine configuration for 0574
#@MAINTAINER: Elettronica GF

require conf/machine/include/imx-base.inc
require conf/machine/include/tune-cortexa7.inc

SOC_FAMILY = "mx7:mx7d"

KERNEL_DEVICETREE = "imx7d-egf-WID0575_AA01.01.dtb \
					 imx7d-egf-WID0575_AA01.01.dtb \
					 "

#config non utilizzate, uboot 
UBOOT_CONFIG ??= "sd"
UBOOT_CONFIG[sd] = "mx7d_12x12_lpddr3_arm2_config,sdcard"
UBOOT_CONFIG[emmc] = "mx7d_12x12_lpddr3_arm2_config,sdcard"
UBOOT_CONFIG[mfgtool] = "mx7d_12x12_lpddr3_arm2_config"

KERNEL_IMAGETYPE = "zImage"

SERIAL_CONSOLE = "115200 ttymxc0"
```

## conf/machine/0659sbc.conf
```bitbake
#@TYPE: Machine
#@NAME: ElettronicaGF SBC imx6ull
#@SOC: i.MX6ULL
#@DESCRIPTION: Machine configuration for ElettronicaGF SBC imx6ull

MACHINEOVERRIDES =. "mx6:mx6ull:"

include conf/machine/include/imx-base.inc
include conf/machine/include/tune-cortexa7.inc

UBOOT_CONFIG ??= "sd"
UBOOT_CONFIG[sd] = "mx6ull_14x14_evk_config,sdcard"
UBOOT_CONFIG[mfgtool] = "mx6ull_14x14_evk_config"

PREFERRED_PROVIDER_u-boot = "u-boot-imx"
PREFERRED_PROVIDER_virtual/bootloader = "u-boot-imx"
#PREFERRED_PROVIDER_virtual/kernel = "linux-dummy"
#PREFERRED_PROVIDER_virtual/kernel_mx6ull = "linux-dummy"

SERIAL_CONSOLE = "115200 ttymxc2"
SERIAL_CONSOLES = "115200;ttymxc2"

MACHINE_FEATURES += "wifi bluetooth"
```

## conf/machine/imx8mp-ddr4-evk.conf
```bitbake
#@TYPE: Machine
#@NAME: NXP i.MX 8M Plus EVK with LPDDR4
#@SOC: i.MX8MP
#@DESCRIPTION: Machine configuration for NXP i.MX 8M Plus Evaluation Kit with LPDDR4
#@MAINTAINER: Jun Zhu <junzhu@nxp.com>

require include/imx8mp-evk.inc

# The device tree name is implicit for LPDDR4, so can't use MACHINE here
KERNEL_DEVICETREE_BASENAME = "imx8mp-evk"

KERNEL_DEVICETREE:remove:use-nxp-bsp = " \
 freescale/imx8mp-evk-dsp-lpa.dtb \"

UBOOT_CONFIG_BASENAME = "imx8mp_evk"
UBOOT_CONFIG[fspi] = "${UBOOT_CONFIG_BASENAME}_defconfig"
UBOOT_CONFIG[ndm]  = "${UBOOT_CONFIG_BASENAME}_ndm_defconfig"

# Set DDR FIRMWARE
DDR_FIRMWARE_VERSION = "202006"
DDR_FIRMWARE_NAME = " \
    lpddr4_pmu_train_1d_dmem_${DDR_FIRMWARE_VERSION}.bin \
    lpddr4_pmu_train_1d_imem_${DDR_FIRMWARE_VERSION}.bin \
    lpddr4_pmu_train_2d_dmem_${DDR_FIRMWARE_VERSION}.bin \
    lpddr4_pmu_train_2d_imem_${DDR_FIRMWARE_VERSION}.bin \
"

IMXBOOT_TARGETS_BASENAME = "flash_evk"

# Mainline BSP doesn't support LPDDR4 so it must be set to nxp.
# Also this machine isn't supported by u-boot-fslc but imx8mn-evk.inc already
# set the bootloader to u-boot-imx instead when NXP BSP is used.
IMX_DEFAULT_BSP = "nxp"
```
